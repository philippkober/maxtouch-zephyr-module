## dts/bindings/input/microchip,maxtouch.yaml
```yaml
description: |
  Input driver for Microchip maxTouch devices

include: ["i2c-device.yaml"]

compatible: "microchip,maxtouch"

properties:
  chg-gpios:
    type: phandle-array
    description: CHG pin for the device
    required: true
  max-touch-points:
    type: int
    default: 5
  repeat-each-cycle:
    type: boolean
    description: Repeat events for any active touches each scan, even if no changes detected.
  swap-xy:
    type: boolean
  invert-x:
    type: boolean
  invert-y:
    type: boolean
  idle-acq-time-ms:
    type: int
    default: 32
  active-acq-time-ms:
    type: int
    default: 10
  active-to-idle-timeout-ms:
    type: int
    default: 50
  sensor-width:
    type: int
    description: The physical width of the sensor in millimeters.
    required: true
  sensor-height:
    type: int
    description: The physical height of the sensor in millimeters.
    required: true
  x-lines:
    type: int
    description: Number of X lines actually connected on the sensor PCB. Defaults to the controller's maximum matrix size from the info block.
  y-lines:
    type: int
    description: Number of Y lines actually connected on the sensor PCB. Defaults to the controller's maximum matrix size from the info block.
  touch_threshold:
    type: int
    description: Touches must exceed this threshold before they generate an event. Higher thresolds are good for tracking smaller objects. Changes to the sensor surface, or the gain may require this value to be changed.
    default: 18
  touch_hysteresis:
    type: int
    description: A hysteresis for touches dropping our of detection. Changes to the sensor surface, or the gain may require this value to be changed.
    default: 8
  internal_touch_threshold:
    type: int
    description: A secondary touch thresold used internally by the sensor. Changes to the sensor surface, or the gain may require this value to be changed.
    default: 10
  internal_touch_hysteresis:
    type: int
    description: A secondary hysteresis used internally by the sensor. Changes to the sensor surface, or the gain may require this value to be changed.
    default: 4
  gain:
    type: int
    description: The transmit power. Higher values allow the use of thicker touch surfaces or higher touch thresholds.
    default: 4
  charge_time:
    type: int
    default: 10
  allowed_measurement_types:
    type: int
    description: Some sensor configurations place restrictions on the available measurement types. A value of 1 (mutual capacitance only) will always work.
    default: 3
  active_syncs_per_x:
    type: int
    default: 20
  idle_syncs_per_x:
    type: int
    default: 20
  retransmission_compensation_disable:
    type: boolean
  diag-dump:
    type: boolean
    description: Log T37 reference values once after init and delta values every 3s (diagnostics only).
  x-pitch:
    type: int
    description: Pitch between X lines in 0.1 mm. Default is sensor-width / x-lines.
  y-pitch:
    type: int
    description: Pitch between Y lines in 0.1 mm. Default is sensor-height / y-lines.
  move-hysteresis-initial:
    type: int
    default: 10
    description: T100 MOVHYSTI, movement needed before the first move event.
  move-hysteresis-next:
    type: int
    default: 4
    description: T100 MOVHYSTN, movement hysteresis for subsequent move events (higher = less jitter).
  confthr:
    type: int
    default: 0
    description: T100 CFG2 touch debounce (confidence threshold).
  shieldless-enable:
    type: boolean
    description: Enable the T56 shieldless noise suppression (used by the author for Procyon boards).
  move-smooth:
    type: int
    default: 0
    description: T100 MOVSMOOTH, smoothing applied to slow movements (tails off at higher speeds).
  merge-threshold:
    type: int
    default: 5
    description: T100 MRGTHR, lower values make the controller separate nearby touches more readily.
  merge-hysteresis:
    type: int
    default: 10
    description: T100 MRGHYST, hysteresis for the merge threshold.
  scroll-momentum:
    type: boolean
    description: Keep scrolling with decaying speed after lifting two fingers (cancelled by a new touch).
```
